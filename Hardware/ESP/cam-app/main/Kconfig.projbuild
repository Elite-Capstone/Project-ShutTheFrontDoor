## Hardware/ESP/main-app/main/Kconfig.projbuild
```kconfig
menu "Project ShutTheFrontDoor Configuration"

    menu "GPIO Configuration"

        choice MCU_TYPE
            prompt "Which MCU will this firmware be installed on?"
            default MAIN_MCU
            help
                The selected MCU type will have different functionalities installed
            
            config MAIN_MCU
                bool "Main MCU"
            config ESP32_CAM_MCU
                bool "ESP32 CAM"
        endchoice

        menu "Input Configuration"

            choice GPIO_INPUT_BOOT
                prompt "Boot button"
                default GPIO_INPUT_22_BOOT
                help
                    The selected GPIO will be pulled down when the button is pressed

                config GPIO_INPUT_0_BOOT
                    bool "GPIO 0"
                config GPIO_INPUT_2_BOOT
                    bool "GPIO 2"
                config GPIO_INPUT_4_BOOT
                    bool "GPIO 4"
                config GPIO_INPUT_5_BOOT
                    bool "GPIO 5"
                config GPIO_INPUT_6_BOOT
                    bool "GPIO 6"
                config GPIO_INPUT_7_BOOT
                    bool "GPIO 7"
                config GPIO_INPUT_8_BOOT
                    bool "GPIO 8"
                config GPIO_INPUT_9_BOOT
                    bool "GPIO 9"
                config GPIO_INPUT_10_BOOT
                    bool "GPIO 10"
                config GPIO_INPUT_11_BOOT
                    bool "GPIO 11"
                config GPIO_INPUT_12_BOOT
                    bool "GPIO 12"
                config GPIO_INPUT_13_BOOT
                    bool "GPIO 13"
                config GPIO_INPUT_14_BOOT
                    bool "GPIO 14"
                config GPIO_INPUT_15_BOOT
                    bool "GPIO 15"
                config GPIO_INPUT_16_BOOT
                    bool "GPIO 16"
                config GPIO_INPUT_17_BOOT
                    bool "GPIO 17"
                config GPIO_INPUT_18_BOOT
                    bool "GPIO 18"
                config GPIO_INPUT_19_BOOT
                    bool "GPIO 19"
                config GPIO_INPUT_21_BOOT
                    bool "GPIO 21"
                config GPIO_INPUT_22_BOOT
                    bool "GPIO 22"
                config GPIO_INPUT_23_BOOT
                    bool "GPIO 23"
                config GPIO_INPUT_25_BOOT
                    bool "GPIO 25"
                config GPIO_INPUT_26_BOOT
                    bool "GPIO 26"
                config GPIO_INPUT_27_BOOT
                    bool "GPIO 27"
                config GPIO_INPUT_32_BOOT
                    bool "GPIO 32"
                config GPIO_INPUT_33_BOOT
                    bool "GPIO 33"
                config GPIO_INPUT_34_BOOT
                    bool "GPIO 34"
                config GPIO_INPUT_35_BOOT
                    bool "GPIO 35"
                config GPIO_INPUT_36_BOOT
                    bool "GPIO 36"
                config GPIO_INPUT_39_BOOT
                    bool "GPIO 39"
            endchoice

            choice GPIO_INPUT_MS
                prompt "Motion Sensor"
                default GPIO_INPUT_15_MS
                help
                    The selected GPIO will be pulled down and the motion sensor will pull the line high

                config GPIO_INPUT_0_MS
                    bool "GPIO 0"
                config GPIO_INPUT_2_MS
                    bool "GPIO 2"
                config GPIO_INPUT_4_MS
                    bool "GPIO 4"
                config GPIO_INPUT_5_MS
                    bool "GPIO 5"
                config GPIO_INPUT_6_MS
                    bool "GPIO 6"
                config GPIO_INPUT_7_MS
                    bool "GPIO 7"
                config GPIO_INPUT_8_MS
                    bool "GPIO 8"
                config GPIO_INPUT_9_MS
                    bool "GPIO 9"
                config GPIO_INPUT_10_MS
                    bool "GPIO 10"
                config GPIO_INPUT_11_MS
                    bool "GPIO 11"
                config GPIO_INPUT_12_MS
                    bool "GPIO 12"
                config GPIO_INPUT_13_MS
                    bool "GPIO 13"
                config GPIO_INPUT_14_MS
                    bool "GPIO 14"
                config GPIO_INPUT_15_MS
                    bool "GPIO 15"
                config GPIO_INPUT_16_MS
                    bool "GPIO 16"
                config GPIO_INPUT_17_MS
                    bool "GPIO 17"
                config GPIO_INPUT_18_MS
                    bool "GPIO 18"
                config GPIO_INPUT_19_MS
                    bool "GPIO 19"
                config GPIO_INPUT_21_MS
                    bool "GPIO 21"
                config GPIO_INPUT_22_MS
                    bool "GPIO 22"
                config GPIO_INPUT_23_MS
                    bool "GPIO 23"
                config GPIO_INPUT_25_MS
                    bool "GPIO 25"
                config GPIO_INPUT_26_MS
                    bool "GPIO 26"
                config GPIO_INPUT_27_MS
                    bool "GPIO 27"
                config GPIO_INPUT_32_MS
                    bool "GPIO 32"
                config GPIO_INPUT_33_MS
                    bool "GPIO 33"
                config GPIO_INPUT_34_MS
                    bool "GPIO 34"
                config GPIO_INPUT_35_MS
                    bool "GPIO 35"
                config GPIO_INPUT_36_MS
                    bool "GPIO 36"
                config GPIO_INPUT_39_MS
                    bool "GPIO 39"
            endchoice

            choice GPIO_INPUT_MOTOR_FAULT
                prompt "GPIO motor fault/stall current detection"
                default GPIO_INPUT_25_MOTOR_FAULT
                help
                    The GPIO will be pulled low when a fault current or stall current is detected by the motor controller
                
                config GPIO_INPUT_0_MOTOR_FAULT
                    bool "GPIO 0"
                config GPIO_INPUT_2_MOTOR_FAULT
                    bool "GPIO 2"
                config GPIO_INPUT_4_MOTOR_FAULT
                    bool "GPIO 4"
                config GPIO_INPUT_5_MOTOR_FAULT
                    bool "GPIO 5"
                config GPIO_INPUT_6_MOTOR_FAULT
                    bool "GPIO 6"
                config GPIO_INPUT_7_MOTOR_FAULT
                    bool "GPIO 7"
                config GPIO_INPUT_8_MOTOR_FAULT
                    bool "GPIO 8"
                config GPIO_INPUT_9_MOTOR_FAULT
                    bool "GPIO 9"
                config GPIO_INPUT_10_MOTOR_FAULT
                    bool "GPIO 10"
                config GPIO_INPUT_11_MOTOR_FAULT
                    bool "GPIO 11"
                config GPIO_INPUT_12_MOTOR_FAULT
                    bool "GPIO 12"
                config GPIO_INPUT_13_MOTOR_FAULT
                    bool "GPIO 13"
                config GPIO_INPUT_14_MOTOR_FAULT
                    bool "GPIO 14"
                config GPIO_INPUT_15_MOTOR_FAULT
                    bool "GPIO 15"
                config GPIO_INPUT_16_MOTOR_FAULT
                    bool "GPIO 16"
                config GPIO_INPUT_17_MOTOR_FAULT
                    bool "GPIO 17"
                config GPIO_INPUT_18_MOTOR_FAULT
                    bool "GPIO 18"
                config GPIO_INPUT_19_MOTOR_FAULT
                    bool "GPIO 19"
                config GPIO_INPUT_21_MOTOR_FAULT
                    bool "GPIO 21"
                config GPIO_INPUT_22_MOTOR_FAULT
                    bool "GPIO 22"
                config GPIO_INPUT_23_MOTOR_FAULT
                    bool "GPIO 23"
                config GPIO_INPUT_25_MOTOR_FAULT
                    bool "GPIO 25"
                config GPIO_INPUT_26_MOTOR_FAULT
                    bool "GPIO 26"
                config GPIO_INPUT_27_MOTOR_FAULT
                    bool "GPIO 27"
                config GPIO_INPUT_32_MOTOR_FAULT
                    bool "GPIO 32"
                config GPIO_INPUT_33_MOTOR_FAULT
                    bool "GPIO 33"
                config GPIO_INPUT_34_MOTOR_FAULT
                    bool "GPIO 34"
                config GPIO_INPUT_35_MOTOR_FAULT
                    bool "GPIO 35"
                config GPIO_INPUT_36_MOTOR_FAULT
                    bool "GPIO 36"
                config GPIO_INPUT_39_MOTOR_FAULT
                    bool "GPIO 39"
            endchoice

            choice GPIO_INPUT_NSW
                prompt "GPIO to detect N-switch position"
                default GPIO_INPUT_26_NSW
                help
                    The GPIO will detect the position of the lock gear

                config GPIO_INPUT_0_NSW
                    bool "GPIO 0"
                config GPIO_INPUT_2_NSW
                    bool "GPIO 2"
                config GPIO_INPUT_4_NSW
                    bool "GPIO 4"
                config GPIO_INPUT_5_NSW
                    bool "GPIO 5"
                config GPIO_INPUT_6_NSW
                    bool "GPIO 6"
                config GPIO_INPUT_7_NSW
                    bool "GPIO 7"
                config GPIO_INPUT_8_NSW
                    bool "GPIO 8"
                config GPIO_INPUT_9_NSW
                    bool "GPIO 9"
                config GPIO_INPUT_10_NSW
                    bool "GPIO 10"
                config GPIO_INPUT_11_NSW
                    bool "GPIO 11"
                config GPIO_INPUT_12_NSW
                    bool "GPIO 12"
                config GPIO_INPUT_13_NSW
                    bool "GPIO 13"
                config GPIO_INPUT_14_NSW
                    bool "GPIO 14"
                config GPIO_INPUT_15_NSW
                    bool "GPIO 15"
                config GPIO_INPUT_16_NSW
                    bool "GPIO 16"
                config GPIO_INPUT_17_NSW
                    bool "GPIO 17"
                config GPIO_INPUT_18_NSW
                    bool "GPIO 18"
                config GPIO_INPUT_19_NSW
                    bool "GPIO 19"
                config GPIO_INPUT_21_NSW
                    bool "GPIO 21"
                config GPIO_INPUT_22_NSW
                    bool "GPIO 22"
                config GPIO_INPUT_23_NSW
                    bool "GPIO 23"
                config GPIO_INPUT_25_NSW
                    bool "GPIO 25"
                config GPIO_INPUT_26_NSW
                    bool "GPIO 26"
                config GPIO_INPUT_27_NSW
                    bool "GPIO 27"
                config GPIO_INPUT_32_NSW
                    bool "GPIO 32"
                config GPIO_INPUT_33_NSW
                    bool "GPIO 33"
                config GPIO_INPUT_34_NSW
                    bool "GPIO 34"
                config GPIO_INPUT_35_NSW
                    bool "GPIO 35"
                config GPIO_INPUT_36_NSW
                    bool "GPIO 36"
                config GPIO_INPUT_39_NSW
                    bool "GPIO 39"
            endchoice

            choice GPIO_INPUT_BATTERY
                prompt "GPIO for Battery voltage"
                default GPIO_INPUT_27_BATTERY
                help 
                    The GPIO will be an ADC which will detect the current voltage level of the battery

                config GPIO_INPUT_0_BATTERY
                    bool "GPIO 0"
                config GPIO_INPUT_2_BATTERY
                    bool "GPIO 2"
                config GPIO_INPUT_4_BATTERY
                    bool "GPIO 4"
                config GPIO_INPUT_12_BATTERY
                    bool "GPIO 12"
                config GPIO_INPUT_13_BATTERY
                    bool "GPIO 13"
                config GPIO_INPUT_14_BATTERY
                    bool "GPIO 14"
                config GPIO_INPUT_15_BATTERY
                    bool "GPIO 15"
                config GPIO_INPUT_25_BATTERY
                    bool "GPIO 25"
                config GPIO_INPUT_26_BATTERY
                    bool "GPIO 26"
                config GPIO_INPUT_27_BATTERY
                    bool "GPIO 27"
                config GPIO_INPUT_32_BATTERY
                    bool "GPIO 32"
                config GPIO_INPUT_33_BATTERY
                    bool "GPIO 33"
                config GPIO_INPUT_34_BATTERY
                    bool "GPIO 34"
                config GPIO_INPUT_35_BATTERY
                    bool "GPIO 35"
                config GPIO_INPUT_36_BATTERY
                    bool "GPIO 36"
                config GPIO_INPUT_39_BATTERY
                    bool "GPIO 39"
            endchoice

            choice GPIO_INPUT_DOORBELL_NOTIF
                prompt "GPIO to send notification on doorbell push"
                default GPIO_INPUT_34_DRBELL_NOTIF
                help 
                    The selected GPIO will be pulled high and must be pulled down to signal the doorbell has been pressed

                config GPIO_INPUT_0_DRBELL_NOTIF
                    bool "GPIO 0"
                config GPIO_INPUT_2_DRBELL_NOTIF
                    bool "GPIO 2"
                config GPIO_INPUT_4_DRBELL_NOTIF
                    bool "GPIO 4"
                config GPIO_INPUT_5_DRBELL_NOTIF
                    bool "GPIO 5"
                config GPIO_INPUT_6_DRBELL_NOTIF
                    bool "GPIO 6"
                config GPIO_INPUT_7_DRBELL_NOTIF
                    bool "GPIO 7"
                config GPIO_INPUT_8_DRBELL_NOTIF
                    bool "GPIO 8"
                config GPIO_INPUT_9_DRBELL_NOTIF
                    bool "GPIO 9"
                config GPIO_INPUT_10_DRBELL_NOTIF
                    bool "GPIO 10"
                config GPIO_INPUT_11_DRBELL_NOTIF
                    bool "GPIO 11"
                config GPIO_INPUT_12_DRBELL_NOTIF
                    bool "GPIO 12"
                config GPIO_INPUT_13_DRBELL_NOTIF
                    bool "GPIO 13"
                config GPIO_INPUT_14_DRBELL_NOTIF
                    bool "GPIO 14"
                config GPIO_INPUT_15_DRBELL_NOTIF
                    bool "GPIO 15"
                config GPIO_INPUT_16_DRBELL_NOTIF
                    bool "GPIO 16"
                config GPIO_INPUT_17_DRBELL_NOTIF
                    bool "GPIO 17"
                config GPIO_INPUT_18_DRBELL_NOTIF
                    bool "GPIO 18"
                config GPIO_INPUT_19_DRBELL_NOTIF
                    bool "GPIO 19"
                config GPIO_INPUT_21_DRBELL_NOTIF
                    bool "GPIO 21"
                config GPIO_INPUT_22_DRBELL_NOTIF
                    bool "GPIO 22"
                config GPIO_INPUT_23_DRBELL_NOTIF
                    bool "GPIO 23"
                config GPIO_INPUT_25_DRBELL_NOTIF
                    bool "GPIO 25"
                config GPIO_INPUT_26_DRBELL_NOTIF
                    bool "GPIO 26"
                config GPIO_INPUT_27_DRBELL_NOTIF
                    bool "GPIO 27"
                config GPIO_INPUT_32_DRBELL_NOTIF
                    bool "GPIO 32"
                config GPIO_INPUT_33_DRBELL_NOTIF
                    bool "GPIO 33"
                config GPIO_INPUT_34_DRBELL_NOTIF
                    bool "GPIO 34"
                config GPIO_INPUT_35_DRBELL_NOTIF
                    bool "GPIO 35"
                config GPIO_INPUT_36_DRBELL_NOTIF
                    bool "GPIO 36"
                config GPIO_INPUT_39_DRBELL_NOTIF
                    bool "GPIO 39"
            endchoice

            choice GPIO_INPUT_DOOR_REEDSW_STATUS
                prompt "GPIO to signal when door has been open/closed"
                default GPIO_INPUT_35_REEDSW_STATUS
                help 
                    The selected GPIO will be pulled high and must be pulled down to toggle the door open/close status

                config GPIO_INPUT_0_REEDSW_STATUS
                    bool "GPIO 0"
                config GPIO_INPUT_2_REEDSW_STATUS
                    bool "GPIO 2"
                config GPIO_INPUT_4_REEDSW_STATUS
                    bool "GPIO 4"
                config GPIO_INPUT_5_REEDSW_STATUS
                    bool "GPIO 5"
                config GPIO_INPUT_6_REEDSW_STATUS
                    bool "GPIO 6"
                config GPIO_INPUT_7_REEDSW_STATUS
                    bool "GPIO 7"
                config GPIO_INPUT_8_REEDSW_STATUS
                    bool "GPIO 8"
                config GPIO_INPUT_9_REEDSW_STATUS
                    bool "GPIO 9"
                config GPIO_INPUT_10_REEDSW_STATUS
                    bool "GPIO 10"
                config GPIO_INPUT_11_REEDSW_STATUS
                    bool "GPIO 11"
                config GPIO_INPUT_12_REEDSW_STATUS
                    bool "GPIO 12"
                config GPIO_INPUT_13_REEDSW_STATUS
                    bool "GPIO 13"
                config GPIO_INPUT_14_REEDSW_STATUS
                    bool "GPIO 14"
                config GPIO_INPUT_15_REEDSW_STATUS
                    bool "GPIO 15"
                config GPIO_INPUT_16_REEDSW_STATUS
                    bool "GPIO 16"
                config GPIO_INPUT_17_REEDSW_STATUS
                    bool "GPIO 17"
                config GPIO_INPUT_18_REEDSW_STATUS
                    bool "GPIO 18"
                config GPIO_INPUT_19_REEDSW_STATUS
                    bool "GPIO 19"
                config GPIO_INPUT_21_REEDSW_STATUS
                    bool "GPIO 21"
                config GPIO_INPUT_22_REEDSW_STATUS
                    bool "GPIO 22"
                config GPIO_INPUT_23_REEDSW_STATUS
                    bool "GPIO 23"
                config GPIO_INPUT_25_REEDSW_STATUS
                    bool "GPIO 25"
                config GPIO_INPUT_26_REEDSW_STATUS
                    bool "GPIO 26"
                config GPIO_INPUT_27_REEDSW_STATUS
                    bool "GPIO 27"
                config GPIO_INPUT_32_REEDSW_STATUS
                    bool "GPIO 32"
                config GPIO_INPUT_33_REEDSW_STATUS
                    bool "GPIO 33"
                config GPIO_INPUT_34_REEDSW_STATUS
                    bool "GPIO 34"
                config GPIO_INPUT_35_REEDSW_STATUS
                    bool "GPIO 35"
                config GPIO_INPUT_36_REEDSW_STATUS
                    bool "GPIO 36"
                config GPIO_INPUT_39_REEDSW_STATUS
                    bool "GPIO 39"
            endchoice

        endmenu

        menu "Output Configuration"

            choice GPIO_OUTPUT_MOTOR_IN1
                prompt "GPIO Motor IN 1"
                default GPIO_OUTPUT_33_MOTOR_IN1
                help 
                    The selected GPIO will trigger the clockwise rotation of the motor

                config GPIO_OUTPUT_0_MOTOR_IN1
                    bool "GPIO 0"
                config GPIO_OUTPUT_2_MOTOR_IN1
                    bool "GPIO 2"
                config GPIO_OUTPUT_4_MOTOR_IN1
                    bool "GPIO 4"
                config GPIO_OUTPUT_5_MOTOR_IN1
                    bool "GPIO 5"
                config GPIO_OUTPUT_6_MOTOR_IN1
                    bool "GPIO 6"
                config GPIO_OUTPUT_7_MOTOR_IN1
                    bool "GPIO 7"
                config GPIO_OUTPUT_8_MOTOR_IN1
                    bool "GPIO 8"
                config GPIO_OUTPUT_9_MOTOR_IN1
                    bool "GPIO 9"
                config GPIO_OUTPUT_10_MOTOR_IN1
                    bool "GPIO 10"
                config GPIO_OUTPUT_11_MOTOR_IN1
                    bool "GPIO 11"
                config GPIO_OUTPUT_12_MOTOR_IN1
                    bool "GPIO 12"
                config GPIO_OUTPUT_13_MOTOR_IN1
                    bool "GPIO 13"
                config GPIO_OUTPUT_14_MOTOR_IN1
                    bool "GPIO 14"
                config GPIO_OUTPUT_15_MOTOR_IN1
                    bool "GPIO 15"
                config GPIO_OUTPUT_16_MOTOR_IN1
                    bool "GPIO 16"
                config GPIO_OUTPUT_17_MOTOR_IN1
                    bool "GPIO 17"
                config GPIO_OUTPUT_18_MOTOR_IN1
                    bool "GPIO 18"
                config GPIO_OUTPUT_19_MOTOR_IN1
                    bool "GPIO 19"
                config GPIO_OUTPUT_21_MOTOR_IN1
                    bool "GPIO 21"
                config GPIO_OUTPUT_22_MOTOR_IN1
                    bool "GPIO 22"
                config GPIO_OUTPUT_23_MOTOR_IN1
                    bool "GPIO 23"
                config GPIO_OUTPUT_25_MOTOR_IN1
                    bool "GPIO 25"
                config GPIO_OUTPUT_26_MOTOR_IN1
                    bool "GPIO 26"
                config GPIO_OUTPUT_27_MOTOR_IN1
                    bool "GPIO 27"
                config GPIO_OUTPUT_32_MOTOR_IN1
                    bool "GPIO 32"
                config GPIO_OUTPUT_33_MOTOR_IN1
                    bool "GPIO 33"
                config GPIO_OUTPUT_34_MOTOR_IN1
                    bool "GPIO 34"
                config GPIO_OUTPUT_35_MOTOR_IN1
                    bool "GPIO 35"
                config GPIO_OUTPUT_36_MOTOR_IN1
                    bool "GPIO 36"
                config GPIO_OUTPUT_39_MOTOR_IN1
                    bool "GPIO 39"
            endchoice

            choice GPIO_OUTPUT_MOTOR_IN2
                prompt "GPIO Motor IN 1"
                default GPIO_OUTPUT_32_MOTOR_IN2
                help 
                    The selected GPIO will trigger the clockwise rotation of the motor

                config GPIO_OUTPUT_0_MOTOR_IN2
                    bool "GPIO 0"
                config GPIO_OUTPUT_2_MOTOR_IN2
                    bool "GPIO 2"
                config GPIO_OUTPUT_4_MOTOR_IN2
                    bool "GPIO 4"
                config GPIO_OUTPUT_5_MOTOR_IN2
                    bool "GPIO 5"
                config GPIO_OUTPUT_6_MOTOR_IN2
                    bool "GPIO 6"
                config GPIO_OUTPUT_7_MOTOR_IN2
                    bool "GPIO 7"
                config GPIO_OUTPUT_8_MOTOR_IN2
                    bool "GPIO 8"
                config GPIO_OUTPUT_9_MOTOR_IN2
                    bool "GPIO 9"
                config GPIO_OUTPUT_10_MOTOR_IN2
                    bool "GPIO 10"
                config GPIO_OUTPUT_11_MOTOR_IN2
                    bool "GPIO 11"
                config GPIO_OUTPUT_12_MOTOR_IN2
                    bool "GPIO 12"
                config GPIO_OUTPUT_13_MOTOR_IN2
                    bool "GPIO 13"
                config GPIO_OUTPUT_14_MOTOR_IN2
                    bool "GPIO 14"
                config GPIO_OUTPUT_15_MOTOR_IN2
                    bool "GPIO 15"
                config GPIO_OUTPUT_16_MOTOR_IN2
                    bool "GPIO 16"
                config GPIO_OUTPUT_17_MOTOR_IN2
                    bool "GPIO 17"
                config GPIO_OUTPUT_18_MOTOR_IN2
                    bool "GPIO 18"
                config GPIO_OUTPUT_19_MOTOR_IN2
                    bool "GPIO 19"
                config GPIO_OUTPUT_21_MOTOR_IN2
                    bool "GPIO 21"
                config GPIO_OUTPUT_22_MOTOR_IN2
                    bool "GPIO 22"
                config GPIO_OUTPUT_23_MOTOR_IN2
                    bool "GPIO 23"
                config GPIO_OUTPUT_25_MOTOR_IN2
                    bool "GPIO 25"
                config GPIO_OUTPUT_26_MOTOR_IN2
                    bool "GPIO 26"
                config GPIO_OUTPUT_27_MOTOR_IN2
                    bool "GPIO 27"
                config GPIO_OUTPUT_32_MOTOR_IN2
                    bool "GPIO 32"
                config GPIO_OUTPUT_33_MOTOR_IN2
                    bool "GPIO 33"
                config GPIO_OUTPUT_34_MOTOR_IN2
                    bool "GPIO 34"
                config GPIO_OUTPUT_35_MOTOR_IN2
                    bool "GPIO 35"
                config GPIO_OUTPUT_36_MOTOR_IN2
                    bool "GPIO 36"
                config GPIO_OUTPUT_39_MOTOR_IN2
                    bool "GPIO 39"
            endchoice

        endmenu

    endmenu

    menu "Picture Configuration"
        
        choice IMAGE_FORMAT_SIZE
            prompt "Image format output size"
            default IMAGE_FORMAT_QVGA
            help
                Select the captured picture's format size. Do not use sizes above QVGA when not JPEG (Listed in ascending order)
            
            config IMAGE_FORMAT_QVGA
                bool "QVGA"
            config IMAGE_FORMAT_CIF
                bool "CIF"
            config IMAGE_FORMAT_VGA
                bool "VGA"
            config IMAGE_FORMAT_SVGA
                bool "SVGA"
            config IMAGE_FORMAT_XGA
                bool "XGA"
            config IMAGE_FORMAT_SXGA
                bool "SXGA"
            config CAM_FRAMESIZE_UXGA
                bool "UXGA"
        endchoice

        choice IMAGE_PIXEL_FORMAT
            prompt "Image pixel output format"
            default IMAGE_PIXEL_JPEG
            help
                Select the captured picture's pixel format
            
            config IMAGE_PIXEL_JPEG
                bool "JPEG"
            config IMAGE_PIXEL_YUV422
                bool "YUV422"
            config IMAGE_PIXEL_GRAYSCALE
                bool "Grayscale"
            config IMAGE_PIXEL_RGB565
                bool "RBG 565"
        endchoice

        choice IMAGE_TO_SDCARD
            prompt "Save the pictures to the SD card"
            default IMAGE_TO_HTTP_UPLOAD
            help
                If the pictures are saved to the SD card, they can only be retrieved there. The HTTP request will send the picture to the database.
            
            config IMAGE_TO_SDCARD
                bool "Save to SD card"
            config IMAGE_TO_HTTP_UPLOAD
                bool "Upload through HTTP request"
            config IMAGE_TO_BOTH_PROT
                bool "Save to SD card and upload too"
        endchoice

        config CAM_STREAM_PORT
            int "Streaming Port"
            range 0 9999
            default 80
            help
                Port on which the camera will stream its video feed

    endmenu

    menu "Wifi Configuration"

        choice SCAN_METHOD
            prompt "scan method"
            default WIFI_FAST_SCAN
            help
                scan method for the esp32 to use. Fast connects you - All gives the choice of network to connect to

            config WIFI_FAST_SCAN
                bool "fast - scans and connects to the first that matches SSID and Password"
            config WIFI_ALL_CHANNEL_SCAN_CONNECT
                bool "all - connect automatically"
            config WIFI_ALL_CHANNEL_SCAN_SHOW
                bool "all - show user"
        endchoice

        config WIFI_SSID
            string "WiFi SSID"
            default "Enter Fast-scan SSID"
            help
                SSID (network name) for the example to connect to.

        config WIFI_PASSWORD
            string "WiFi Password"
            default "Enter Fast-scan Password"
            help
                WiFi password (WPA or WPA2) for the example to use.

        config SCAN_LIST_SIZE
            int "Max size of scan list"
            range 0 20
            default 10
            help
                The size of array that will be used to retrieve the list of access points.

        choice SORT_METHOD
            prompt "sort method"
            default WIFI_CONNECT_AP_BY_SIGNAL
            help
                sort method for the esp32 to use

            config WIFI_CONNECT_AP_BY_SIGNAL
                bool "rssi"
            config WIFI_CONNECT_AP_BY_SECURITY
                bool "authmode"
        endchoice

        menu "Fast Scan Extra Configs"

            config WIFI_RETRY_LIMIT
                int "Retry Limit"
                range 0 99
                default 10
                help
                    The number of times the module can retry to connect to the given wifi AP before returning an error.
            
            config FAST_SCAN_THRESHOLD
                bool "fast scan threshold"
                default y
                help
                    wifi fast scan threshold

            config FAST_SCAN_MINIMUM_SIGNAL
                int "fast scan minimum rssi"
                depends on FAST_SCAN_THRESHOLD
                range -127 0
                default -127
                help
                    rssi is use to measure the signal

            choice FAST_SCAN_WEAKEST_AUTHMODE
                prompt "fast scan weakest authmode"
                depends on FAST_SCAN_THRESHOLD
                default FAST_SCAN_WEAKEST_AUTHMODE_OPEN

                config FAST_SCAN_WEAKEST_AUTHMODE_OPEN
                    bool "open"
                config FAST_SCAN_WEAKEST_AUTHMODE_WEP
                    bool "wep"
                config FAST_SCAN_WEAKEST_AUTHMODE_WPA
                    bool "wpa"
                config FAST_SCAN_WEAKEST_AUTHMODE_WPA2
                    bool "wpa2"
            endchoice

        endmenu

    endmenu

endmenu
```
