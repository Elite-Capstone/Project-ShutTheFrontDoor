## Hardware/ESP/cam-app/main/Kconfig.projbuild
```kconfig
menu "Project ShutTheFrontDoor Configuration"

    choice MCU_TYPE
        prompt "Which MCU will this firmware be installed on?"
        default MAIN_MCU
        help
            The selected MCU type will have different functionalities installed.
        
        config MAIN_MCU
            bool "Main MCU"
        config ESP32_CAM_MCU
            bool "ESP32 CAM"
    endchoice

    menu "Google IoT Core Configuration"

        config GIOT_PROJECT_ID
            string "Google Cloud Project ID"
            default "project_id"
            help
                Google Cloud project ID
        
        config GIOT_LOCATION
            string "Google Cloud location"
            default "us-central1"
            help
                Google Cloud region
        
        config GIOT_REGISTRY_ID
            string "Google IoT Core Registry ID"
            default "registry_id"
            help
                Google IoT Core registry id
        
        config GIOT_DEVICE_ID
            string "Google IoT Core Device ID"
            default "device_id"
            help
                Google IoT Core device id
        
        config GIOT_DEBUG_OUTPUT
            bool "Enable debugging"
            help
                Select this option to enable debugging support
        
    endmenu
    
    menu "GPIO Configuration"

        menu "Input Configuration"

            choice GPIO_INPUT_BOOT
                prompt "Boot button"
                default GPIO_INPUT_0_BOOT
                help
                    The selected GPIO will be pulled down when the button is pressed.

                config GPIO_INPUT_0_BOOT
                    bool "GPIO 0"
                config GPIO_INPUT_2_BOOT
                    bool "GPIO 2"
                config GPIO_INPUT_4_BOOT
                    bool "GPIO 4"
                config GPIO_INPUT_5_BOOT
                    bool "GPIO 5"
                config GPIO_INPUT_6_BOOT
                    bool "GPIO 6"
                config GPIO_INPUT_7_BOOT
                    bool "GPIO 7"
                config GPIO_INPUT_8_BOOT
                    bool "GPIO 8"
                config GPIO_INPUT_9_BOOT
                    bool "GPIO 9"
                config GPIO_INPUT_10_BOOT
                    bool "GPIO 10"
                config GPIO_INPUT_11_BOOT
                    bool "GPIO 11"
                config GPIO_INPUT_12_BOOT
                    bool "GPIO 12"
                config GPIO_INPUT_13_BOOT
                    bool "GPIO 13"
                config GPIO_INPUT_14_BOOT
                    bool "GPIO 14"
                config GPIO_INPUT_15_BOOT
                    bool "GPIO 15"
                config GPIO_INPUT_16_BOOT
                    bool "GPIO 16"
                config GPIO_INPUT_17_BOOT
                    bool "GPIO 17"
                config GPIO_INPUT_18_BOOT
                    bool "GPIO 18"
                config GPIO_INPUT_19_BOOT
                    bool "GPIO 19"
                config GPIO_INPUT_21_BOOT
                    bool "GPIO 21"
                config GPIO_INPUT_22_BOOT
                    bool "GPIO 22"
                config GPIO_INPUT_23_BOOT
                    bool "GPIO 23"
                config GPIO_INPUT_25_BOOT
                    bool "GPIO 25"
                config GPIO_INPUT_26_BOOT
                    bool "GPIO 26"
                config GPIO_INPUT_27_BOOT
                    bool "GPIO 27"
                config GPIO_INPUT_32_BOOT
                    bool "GPIO 32"
                config GPIO_INPUT_33_BOOT
                    bool "GPIO 33"
                config GPIO_INPUT_34_BOOT
                    bool "GPIO 34"
                config GPIO_INPUT_35_BOOT
                    bool "GPIO 35"
                config GPIO_INPUT_36_BOOT
                    bool "GPIO 36"
                config GPIO_INPUT_39_BOOT
                    bool "GPIO 39"
            endchoice

            choice GPIO_INPUT_MS
                prompt "Motion Sensor"
                default GPIO_INPUT_16_MS
                help
                    The selected GPIO will be pulled down and the motion sensor will pull the line high.

                config GPIO_INPUT_0_MS
                    bool "GPIO 0"
                config GPIO_INPUT_2_MS
                    bool "GPIO 2"
                config GPIO_INPUT_4_MS
                    bool "GPIO 4"
                config GPIO_INPUT_5_MS
                    bool "GPIO 5"
                config GPIO_INPUT_6_MS
                    bool "GPIO 6"
                config GPIO_INPUT_7_MS
                    bool "GPIO 7"
                config GPIO_INPUT_8_MS
                    bool "GPIO 8"
                config GPIO_INPUT_9_MS
                    bool "GPIO 9"
                config GPIO_INPUT_10_MS
                    bool "GPIO 10"
                config GPIO_INPUT_11_MS
                    bool "GPIO 11"
                config GPIO_INPUT_12_MS
                    bool "GPIO 12"
                config GPIO_INPUT_13_MS
                    bool "GPIO 13"
                config GPIO_INPUT_14_MS
                    bool "GPIO 14"
                config GPIO_INPUT_15_MS
                    bool "GPIO 15"
                config GPIO_INPUT_16_MS
                    bool "GPIO 16"
                config GPIO_INPUT_17_MS
                    bool "GPIO 17"
                config GPIO_INPUT_18_MS
                    bool "GPIO 18"
                config GPIO_INPUT_19_MS
                    bool "GPIO 19"
                config GPIO_INPUT_21_MS
                    bool "GPIO 21"
                config GPIO_INPUT_22_MS
                    bool "GPIO 22"
                config GPIO_INPUT_23_MS
                    bool "GPIO 23"
                config GPIO_INPUT_25_MS
                    bool "GPIO 25"
                config GPIO_INPUT_26_MS
                    bool "GPIO 26"
                config GPIO_INPUT_27_MS
                    bool "GPIO 27"
                config GPIO_INPUT_32_MS
                    bool "GPIO 32"
                config GPIO_INPUT_33_MS
                    bool "GPIO 33"
                config GPIO_INPUT_34_MS
                    bool "GPIO 34"
                config GPIO_INPUT_35_MS
                    bool "GPIO 35"
                config GPIO_INPUT_36_MS
                    bool "GPIO 36"
                config GPIO_INPUT_39_MS
                    bool "GPIO 39"
            endchoice

            choice GPIO_INPUT_PIC
                prompt "Picture Button"
                depends on ESP32_CAM_MCU
                default GPIO_INPUT_14_PIC
                help
                    The selected GPIO will be pulled up and the button will pull the gpio down to trigger the picture taking.

                config GPIO_INPUT_0_PIC
                    bool "GPIO 0"
                config GPIO_INPUT_2_PIC
                    bool "GPIO 2"
                config GPIO_INPUT_4_PIC
                    bool "GPIO 4"
                config GPIO_INPUT_5_PIC
                    bool "GPIO 5"
                config GPIO_INPUT_6_PIC
                    bool "GPIO 6"
                config GPIO_INPUT_7_PIC
                    bool "GPIO 7"
                config GPIO_INPUT_8_PIC
                    bool "GPIO 8"
                config GPIO_INPUT_9_PIC
                    bool "GPIO 9"
                config GPIO_INPUT_10_PIC
                    bool "GPIO 10"
                config GPIO_INPUT_11_PIC
                    bool "GPIO 11"
                config GPIO_INPUT_12_PIC
                    bool "GPIO 12"
                config GPIO_INPUT_13_PIC
                    bool "GPIO 13"
                config GPIO_INPUT_14_PIC
                    bool "GPIO 14"
                config GPIO_INPUT_15_PIC
                    bool "GPIO 15"
                config GPIO_INPUT_16_PIC
                    bool "GPIO 16"
                config GPIO_INPUT_17_PIC
                    bool "GPIO 17"
                config GPIO_INPUT_18_PIC
                    bool "GPIO 18"
                config GPIO_INPUT_19_PIC
                    bool "GPIO 19"
                config GPIO_INPUT_21_PIC
                    bool "GPIO 21"
                config GPIO_INPUT_22_PIC
                    bool "GPIO 22"
                config GPIO_INPUT_23_PIC
                    bool "GPIO 23"
                config GPIO_INPUT_25_PIC
                    bool "GPIO 25"
                config GPIO_INPUT_26_PIC
                    bool "GPIO 26"
                config GPIO_INPUT_27_PIC
                    bool "GPIO 27"
                config GPIO_INPUT_32_PIC
                    bool "GPIO 32"
                config GPIO_INPUT_33_PIC
                    bool "GPIO 33"
                config GPIO_INPUT_34_PIC
                    bool "GPIO 34"
                config GPIO_INPUT_35_PIC
                    bool "GPIO 35"
                config GPIO_INPUT_36_PIC
                    bool "GPIO 36"
                config GPIO_INPUT_39_PIC
                    bool "GPIO 39"
            endchoice

            choice GPIO_INPUT_DOORBELL_NOTIF
                prompt "GPIO to send notification on doorbell push"
                default GPIO_INPUT_13_DRBELL_NOTIF
                help 
                    The selected GPIO will be pulled high and must be pulled down to signal the doorbell has been pressed.

                config GPIO_INPUT_0_DRBELL_NOTIF
                    bool "GPIO 0"
                config GPIO_INPUT_2_DRBELL_NOTIF
                    bool "GPIO 2"
                config GPIO_INPUT_4_DRBELL_NOTIF
                    bool "GPIO 4"
                config GPIO_INPUT_5_DRBELL_NOTIF
                    bool "GPIO 5"
                config GPIO_INPUT_6_DRBELL_NOTIF
                    bool "GPIO 6"
                config GPIO_INPUT_7_DRBELL_NOTIF
                    bool "GPIO 7"
                config GPIO_INPUT_8_DRBELL_NOTIF
                    bool "GPIO 8"
                config GPIO_INPUT_9_DRBELL_NOTIF
                    bool "GPIO 9"
                config GPIO_INPUT_10_DRBELL_NOTIF
                    bool "GPIO 10"
                config GPIO_INPUT_11_DRBELL_NOTIF
                    bool "GPIO 11"
                config GPIO_INPUT_12_DRBELL_NOTIF
                    bool "GPIO 12"
                config GPIO_INPUT_13_DRBELL_NOTIF
                    bool "GPIO 13"
                config GPIO_INPUT_14_DRBELL_NOTIF
                    bool "GPIO 14"
                config GPIO_INPUT_15_DRBELL_NOTIF
                    bool "GPIO 15"
                config GPIO_INPUT_16_DRBELL_NOTIF
                    bool "GPIO 16"
                config GPIO_INPUT_17_DRBELL_NOTIF
                    bool "GPIO 17"
                config GPIO_INPUT_18_DRBELL_NOTIF
                    bool "GPIO 18"
                config GPIO_INPUT_19_DRBELL_NOTIF
                    bool "GPIO 19"
                config GPIO_INPUT_21_DRBELL_NOTIF
                    bool "GPIO 21"
                config GPIO_INPUT_22_DRBELL_NOTIF
                    bool "GPIO 22"
                config GPIO_INPUT_23_DRBELL_NOTIF
                    bool "GPIO 23"
                config GPIO_INPUT_25_DRBELL_NOTIF
                    bool "GPIO 25"
                config GPIO_INPUT_26_DRBELL_NOTIF
                    bool "GPIO 26"
                config GPIO_INPUT_27_DRBELL_NOTIF
                    bool "GPIO 27"
                config GPIO_INPUT_32_DRBELL_NOTIF
                    bool "GPIO 32"
                config GPIO_INPUT_33_DRBELL_NOTIF
                    bool "GPIO 33"
                config GPIO_INPUT_34_DRBELL_NOTIF
                    bool "GPIO 34"
                config GPIO_INPUT_35_DRBELL_NOTIF
                    bool "GPIO 35"
                config GPIO_INPUT_36_DRBELL_NOTIF
                    bool "GPIO 36"
                config GPIO_INPUT_39_DRBELL_NOTIF
                    bool "GPIO 39"
            endchoice

            choice GPIO_INPUT_DOOR_REEDSW_STATUS
                prompt "GPIO to signal when door has been open/closed"
                default GPIO_INPUT_15_REEDSW_STATUS
                help 
                    The selected GPIO will be pulled high and must be pulled down to toggle the door open/close status.

                config GPIO_INPUT_0_REEDSW_STATUS
                    bool "GPIO 0"
                config GPIO_INPUT_2_REEDSW_STATUS
                    bool "GPIO 2"
                config GPIO_INPUT_4_REEDSW_STATUS
                    bool "GPIO 4"
                config GPIO_INPUT_5_REEDSW_STATUS
                    bool "GPIO 5"
                config GPIO_INPUT_6_REEDSW_STATUS
                    bool "GPIO 6"
                config GPIO_INPUT_7_REEDSW_STATUS
                    bool "GPIO 7"
                config GPIO_INPUT_8_REEDSW_STATUS
                    bool "GPIO 8"
                config GPIO_INPUT_9_REEDSW_STATUS
                    bool "GPIO 9"
                config GPIO_INPUT_10_REEDSW_STATUS
                    bool "GPIO 10"
                config GPIO_INPUT_11_REEDSW_STATUS
                    bool "GPIO 11"
                config GPIO_INPUT_12_REEDSW_STATUS
                    bool "GPIO 12"
                config GPIO_INPUT_13_REEDSW_STATUS
                    bool "GPIO 13"
                config GPIO_INPUT_14_REEDSW_STATUS
                    bool "GPIO 14"
                config GPIO_INPUT_15_REEDSW_STATUS
                    bool "GPIO 15"
                config GPIO_INPUT_16_REEDSW_STATUS
                    bool "GPIO 16"
                config GPIO_INPUT_17_REEDSW_STATUS
                    bool "GPIO 17"
                config GPIO_INPUT_18_REEDSW_STATUS
                    bool "GPIO 18"
                config GPIO_INPUT_19_REEDSW_STATUS
                    bool "GPIO 19"
                config GPIO_INPUT_21_REEDSW_STATUS
                    bool "GPIO 21"
                config GPIO_INPUT_22_REEDSW_STATUS
                    bool "GPIO 22"
                config GPIO_INPUT_23_REEDSW_STATUS
                    bool "GPIO 23"
                config GPIO_INPUT_25_REEDSW_STATUS
                    bool "GPIO 25"
                config GPIO_INPUT_26_REEDSW_STATUS
                    bool "GPIO 26"
                config GPIO_INPUT_27_REEDSW_STATUS
                    bool "GPIO 27"
                config GPIO_INPUT_32_REEDSW_STATUS
                    bool "GPIO 32"
                config GPIO_INPUT_33_REEDSW_STATUS
                    bool "GPIO 33"
                config GPIO_INPUT_34_REEDSW_STATUS
                    bool "GPIO 34"
                config GPIO_INPUT_35_REEDSW_STATUS
                    bool "GPIO 35"
                config GPIO_INPUT_36_REEDSW_STATUS
                    bool "GPIO 36"
                config GPIO_INPUT_39_REEDSW_STATUS
                    bool "GPIO 39"
            endchoice

        endmenu

        menu "Output Configuration"

            choice GPIO_OUTPUT_CONFIRM_UPLOAD
                prompt "GPIO confirm output signal"
                depends on ESP32_CAM_MCU
                default GPIO_OUTPUT_CONFIRM_UPLOAD_14
                help 
                    The selected GPIO toggle its output in the goal of blinking an LED.

                config GPIO_OUTPUT_CONFIRM_UPLOAD_0
                    bool "GPIO 0"
                config GPIO_OUTPUT_CONFIRM_UPLOAD_2
                    bool "GPIO 2"
                config GPIO_OUTPUT_CONFIRM_UPLOAD_4
                    bool "GPIO 4"
                config GPIO_OUTPUT_CONFIRM_UPLOAD_5
                    bool "GPIO 5"
                config GPIO_OUTPUT_CONFIRM_UPLOAD_6
                    bool "GPIO 6"
                config GPIO_OUTPUT_CONFIRM_UPLOAD_7
                    bool "GPIO 7"
                config GPIO_OUTPUT_CONFIRM_UPLOAD_8
                    bool "GPIO 8"
                config GPIO_OUTPUT_CONFIRM_UPLOAD_9
                    bool "GPIO 9"
                config GPIO_OUTPUT_CONFIRM_UPLOAD_10
                    bool "GPIO 10"
                config GPIO_OUTPUT_CONFIRM_UPLOAD_11
                    bool "GPIO 11"
                config GPIO_OUTPUT_CONFIRM_UPLOAD_12
                    bool "GPIO 12"
                config GPIO_OUTPUT_CONFIRM_UPLOAD_13
                    bool "GPIO 13"
                config GPIO_OUTPUT_CONFIRM_UPLOAD_14
                    bool "GPIO 14"
                config GPIO_OUTPUT_CONFIRM_UPLOAD_15
                    bool "GPIO 15"
                config GPIO_OUTPUT_CONFIRM_UPLOAD_16
                    bool "GPIO 16"
                config GPIO_OUTPUT_CONFIRM_UPLOAD_17
                    bool "GPIO 17"
                config GPIO_OUTPUT_CONFIRM_UPLOAD_18
                    bool "GPIO 18"
                config GPIO_OUTPUT_CONFIRM_UPLOAD_19
                    bool "GPIO 19"
                config GPIO_OUTPUT_CONFIRM_UPLOAD_21
                    bool "GPIO 21"
                config GPIO_OUTPUT_CONFIRM_UPLOAD_22
                    bool "GPIO 22"
                config GPIO_OUTPUT_CONFIRM_UPLOAD_23
                    bool "GPIO 23"
                config GPIO_OUTPUT_CONFIRM_UPLOAD_25
                    bool "GPIO 25"
                config GPIO_OUTPUT_CONFIRM_UPLOAD_26
                    bool "GPIO 26"
                config GPIO_OUTPUT_CONFIRM_UPLOAD_27
                    bool "GPIO 27"
                config GPIO_OUTPUT_CONFIRM_UPLOAD_32
                    bool "GPIO 32"
                config GPIO_OUTPUT_CONFIRM_UPLOAD_33
                    bool "GPIO 33"
                config GPIO_OUTPUT_CONFIRM_UPLOAD_34
                    bool "GPIO 34"
                config GPIO_OUTPUT_CONFIRM_UPLOAD_35
                    bool "GPIO 35"
                config GPIO_OUTPUT_CONFIRM_UPLOAD_36
                    bool "GPIO 36"
                config GPIO_OUTPUT_CONFIRM_UPLOAD_39
                    bool "GPIO 39"
            endchoice

        endmenu

    endmenu  

    menu "Camera configuration"
        visible if ESP32_CAM_MCU

        config OV7670_SUPPORT
            bool "Support OV7670 VGA"
            default y
            help
                Enable this option if you want to use the OV7670.
                Disable this option to safe memory.
    
        config OV7725_SUPPORT
            bool "Support OV7725 SVGA"
            default n
            help
                Enable this option if you want to use the OV7725.
                Disable this option to save memory.
    
        config NT99141_SUPPORT
            bool "Support NT99141 HD"
            default y
            help
                Enable this option if you want to use the NT99141.
                Disable this option to save memory.
    
        config OV2640_SUPPORT
            bool "Support OV2640 2MP"
            default y
            help
                Enable this option if you want to use the OV2640.
                Disable this option to save memory.
    
        config OV3660_SUPPORT
            bool "Support OV3660 3MP"
            default y
            help
                Enable this option if you want to use the OV3360.
                Disable this option to save memory.
    
        config OV5640_SUPPORT
            bool "Support OV5640 5MP"
            default y
            help
                Enable this option if you want to use the OV5640.
                Disable this option to save memory.
    
        choice SCCB_HARDWARE_I2C_PORT
            bool "I2C peripheral to use for SCCB"
            default SCCB_HARDWARE_I2C_PORT1
    
            config SCCB_HARDWARE_I2C_PORT0
                bool "I2C0"
            config SCCB_HARDWARE_I2C_PORT1
                bool "I2C1"
    
        endchoice
    
        choice CAMERA_TASK_PINNED_TO_CORE
            bool "Camera task pinned to core"
            default CAMERA_CORE0
            help
                Pin the camera handle task to a certain core(0/1). It can also be done automatically choosing NO_AFFINITY.
    
            config CAMERA_CORE0
                bool "CORE0"
            config CAMERA_CORE1
                bool "CORE1"
            config CAMERA_NO_AFFINITY
                bool "NO_AFFINITY"
    
        endchoice
    
    endmenu

    menu "Picture Configuration"
        
        choice IMAGE_FORMAT_SIZE
            prompt "Image format output size"
            default IMAGE_FORMAT_QVGA
            help
                Select the captured picture's format size. Do not use sizes above QVGA when not JPEG (Listed in ascending order).
            
            config IMAGE_FORMAT_QVGA
                bool "QVGA"
            config IMAGE_FORMAT_CIF
                bool "CIF"
            config IMAGE_FORMAT_VGA
                bool "VGA"
            config IMAGE_FORMAT_SVGA
                bool "SVGA"
            config IMAGE_FORMAT_XGA
                bool "XGA"
            config IMAGE_FORMAT_SXGA
                bool "SXGA"
            config CAM_FRAMESIZE_UXGA
                bool "UXGA"
        endchoice

        choice IMAGE_PIXEL_FORMAT
            prompt "Image pixel output format"
            default IMAGE_PIXEL_JPEG
            help
                Select the captured picture's pixel format.
            
            config IMAGE_PIXEL_JPEG
                bool "JPEG"
            config IMAGE_PIXEL_YUV422
                bool "YUV422"
            config IMAGE_PIXEL_GRAYSCALE
                bool "Grayscale"
            config IMAGE_PIXEL_RGB565
                bool "RBG 565"
        endchoice

        choice IMAGE_TO_SDCARD
            prompt "Save the pictures to the SD card"
            default IMAGE_TO_HTTP_UPLOAD
            help
                If the pictures are saved to the SD card, they can only be retrieved there. The HTTP request will send the picture to the database.
            
            config IMAGE_TO_SDCARD
                bool "Save to SD card"
            config IMAGE_TO_HTTP_UPLOAD
                bool "Upload through HTTP request"
            config IMAGE_TO_BOTH_PROT
                bool "Save to SD card and upload too"
        endchoice
    
    endmenu

    menu "Streaming Configuration"

        choice IP_MODE
            prompt "IP Version"
            help
                Client can use either IPV4 or IPV6.

            config IPV4
                bool "IPV4"
            config IPV6
                bool "IPV6"
    
        endchoice
    
        config IPV4_ADDR
            string "IPV4 Address"
            default "192.168.1.165"
            depends on IPV4
            help
                The MCU's TCP client will connect to this IPV4 address.
    
        config IPV6_ADDR
            string "IPV6 Address"
            default "FE80::30AD:E57B:C212:68AD"
            depends on IPV6
            help
                The MCU's TCP client will connect to this IPV6 address.
    
        config TCP_HOST_PORT
            int "Host Port"
            range 0 65535
            default 5555
            help
                The remote port to which the client will connect to.

        config LOCAL_STREAM_PORT
            int "Streaming Port"
            range 0 65535
            default 80
            help
                Port on which the camera will stream its video feed locally.

    endmenu

    menu "Wifi Configuration"

        choice SCAN_METHOD
            prompt "scan method"
            default WIFI_FAST_SCAN
            help
                Scan method for the esp32 to use. Fast connects you - All gives the choice of network to connect to.

            config WIFI_FAST_SCAN
                bool "fast - scans and connects to the first that matches SSID and Password"
            config WIFI_ALL_CHANNEL_SCAN_CONNECT
                bool "all - connect automatically"
            config WIFI_ALL_CHANNEL_SCAN_SHOW
                bool "all - show user"
        endchoice

        config WIFI_SSID
            string "WiFi SSID"
            default "Enter Fast-scan SSID"
            help
                SSID (network name) for the example to connect to.

        config WIFI_PASSWORD
            string "WiFi Password"
            default "Enter Fast-scan Password"
            help
                WiFi password (WPA or WPA2) for the example to use.

        config SCAN_LIST_SIZE
            int "Max size of scan list"
            range 0 20
            default 10
            help
                The size of array that will be used to retrieve the list of access points.

        choice SORT_METHOD
            prompt "sort method"
            default WIFI_CONNECT_AP_BY_SIGNAL
            help
                The sort method for the esp32 to use.

            config WIFI_CONNECT_AP_BY_SIGNAL
                bool "rssi"
            config WIFI_CONNECT_AP_BY_SECURITY
                bool "authmode"
        endchoice


        menu "Fast Scan Extra Configs"

            config WIFI_RETRY_LIMIT
                int "Retry Limit"
                range 0 99
                default 10
                help
                    The number of times the module can retry to connect to the given wifi AP before returning an error.
            
            config FAST_SCAN_THRESHOLD
                bool "fast scan threshold"
                default y
                help
                    wifi fast scan threshold

            config FAST_SCAN_MINIMUM_SIGNAL
                int "fast scan minimum rssi"
                depends on FAST_SCAN_THRESHOLD
                range -127 0
                default -127
                help
                    rssi is used to measure the signal strength

            choice FAST_SCAN_WEAKEST_AUTHMODE
                prompt "fast scan weakest authmode"
                depends on FAST_SCAN_THRESHOLD
                default FAST_SCAN_WEAKEST_AUTHMODE_OPEN

                config FAST_SCAN_WEAKEST_AUTHMODE_OPEN
                    bool "open"
                config FAST_SCAN_WEAKEST_AUTHMODE_WEP
                    bool "wep"
                config FAST_SCAN_WEAKEST_AUTHMODE_WPA
                    bool "wpa"
                config FAST_SCAN_WEAKEST_AUTHMODE_WPA2
                    bool "wpa2"
            endchoice

        endmenu

    endmenu

endmenu
```
