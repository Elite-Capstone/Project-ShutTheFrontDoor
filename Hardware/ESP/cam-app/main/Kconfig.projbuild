## Hardware/ESP/scan/main/Kconfig.projbuild
```kconfig
menu "Wifi Configuration"

    config CONFIG_SCAN_LIST_SIZE
        int "Max size of scan list"
        range 0 20
        default 10
        help
            The size of array that will be used to retrieve the list of access points.

    config WIFI_SSID
        string "WiFi SSID"
        default "NETGEAR30"
        help
            SSID (network name) for the example to connect to.

    config WIFI_PASSWORD
        string "WiFi Password"
        default "deepkayak849"
        help
            WiFi password (WPA or WPA2) for the example to use.

    choice SCAN_METHOD
        prompt "scan method"
        default WIFI_FAST_SCAN
        help
            scan method for the esp32 to use

        config WIFI_FAST_SCAN
            bool "fast"
        config WIFI_ALL_CHANNEL_SCAN
            bool "all"
    endchoice

    choice SORT_METHOD
        prompt "sort method"
        default WIFI_CONNECT_AP_BY_SIGNAL
        help
            sort method for the esp32 to use

        config WIFI_CONNECT_AP_BY_SIGNAL
            bool "rssi"
        config WIFI_CONNECT_AP_BY_SECURITY
            bool "authmode"
    endchoice

    config FAST_SCAN_THRESHOLD
        bool "fast scan threshold"
        default y
        help
            wifi fast scan threshold

    config FAST_SCAN_MINIMUM_SIGNAL
        int "fast scan minimum rssi"
        depends on FAST_SCAN_THRESHOLD
        range -127 0
        default -127
        help
            rssi is use to measure the signal

    choice FAST_SCAN_WEAKEST_AUTHMODE
        prompt "fast scan weakest authmode"
        depends on FAST_SCAN_THRESHOLD
        default FAST_SCAN_WEAKEST_AUTHMODE_OPEN

        config FAST_SCAN_WEAKEST_AUTHMODE_OPEN
            bool "open"
        config FAST_SCAN_WEAKEST_AUTHMODE_WEP
            bool "wep"
        config FAST_SCAN_WEAKEST_AUTHMODE_WPA
            bool "wpa"
        config FAST_SCAN_WEAKEST_AUTHMODE_WPA2
            bool "wpa2"
    endchoice

endmenu
```
